## Kconfig
```kconfig
mainmenu "Mantle OS Builder"
config KAS_INCLUDE_EXOS
        string
        default "exos.yml"

# BUILD TYPE
comment "Build Type"
config HAS_DEV_BUILD
        bool
        prompt "development build type"
        default y
        help
          This is used in the paths in /srv/mantle/${RELEASE_TYPE}

config RELEASE_TYPE
        string
        default "production" if !HAS_DEV_BUILD
        default "development" if HAS_DEV_BUILD

# BSP
comment "BSP(Board Support Packages)"
source "arch/Kconfig"
source "distro/fortran/Kconfig"

# DISTRO
comment "Distro Settings"
source "distro/pid1/Kconfig"
source "distro/unix_tools/Kconfig"
source "distro/ota/Kconfig"
source "distro/de/Kconfig"

# BUILD TIME
comment "Build time Settings"
source "distro/Kconfig"

# About 
comment "Menu Settings"
menu "About"
comment "Exosphere (exos) is a tool to make building mantle os a bit easier"
config HAS_HACKING
        bool "debug the menu(for devlopers)"
        default n

config HAS_DGB_SCREENS
	bool "Debug screens"
	depends on HAS_HACKING
	default n
endmenu
```

## arch/Kconfig
```kconfig
menu "ARCH(Architechtures)"

comment "Architechture"
choice ARCH
	prompt "Supported Architechtures"
	default X86_64
	config X86
		bool "X86 32 bit"
	config X86_64
		bool "x86 64 bit"
	config ARM
		bool "Arm 32 bit"
	config ARM64
		bool "ARM 64"
	config POWER_PC 
		bool "PowerPC 32 bit"
	config POWER_PC 
		bool "PowerPC 64 bit"
	config MIPS
		bool "Mips 32bit"
	config MIPS64
		bool "Mips 64"

endchoice

comment "Board" 
# its really the tune
source "arch/arm/Kconfig"
source "arch/arm64/Kconfig"
source "arch/x86/Kconfig"
source "arch/x86_64/Kconfig"

endmenu
```

## arch/arm/Kconfig
```kconfig
choice ARM_SOC
	prompt "Unsupported at the moment. Will come soon"
	depends on ARM
	default NXP_ARM
	config NXP_ARM
		bool "nxp freescale"
	config ATMEL_ARM
		bool "microchip's(atmel,linux4sam)"
	config TI
		bool "texas instruments"
	config NVIDIA_ARM
		bool "nvidia"
	config POKY_ARM
		bool "Yocto generic arm"
endchoice

config KAS_INCLUDE_ARM_ARCH
	string
#	default "arch/arm/poky/armv5.yml" if ARMV5
#	default "arch/arm/poky/armv7.yml" if ARMV7 


## Source all the soc vendors here.
```

## arch/arm64/Kconfig
```kconfig
choice ARM64_SOC
	prompt "UNSUPPORTED atm check back in a couple days"
	depends on ARM64
	default NXP_ARM64
	config NXP_ARM64
		bool "nxp(freescale/imx)"
	config NVIDIA_ARM64
		bool "nvidia"
	config POKY_ARM64
		bool "Yocto's generic aarm64"
endchoice
```

## arch/x86/Kconfig
```kconfig
choice X86_TUNE
	prompt "Supported x86 Arch"
	depends on X86
	default CORE2_32
	config CORE2_32
		bool "core2-32 -cpu Nehalem"
	config I586
		bool "i586"
	config I686
		bool "i686"
endchoice

config KAS_INCLUDE_X86_ARCH
	string
	default "arch/x86/core2-32.yml" if CORE2_32
	default "arch/x86/i586.yml" if I586
	default "arch/x86/i686.yml" if I686
```

## distro/Kconfig
```kconfig
menuconfig HAS_DL_SSTATE
	bool "Cache Downloads and sstate"
	default y
	help
	  This allows one to set the base directory to where 
	  all the sstate, downloads, parser-cache, prserv, This 
	  saves hours on builds over time. The directories must 
	  exsist on the system with the correct user permissions 
	  to read and write to the folder. example. 
	  sudo mkdir -p /srv/mantle; 
	  sudo chown -R $USER:$USER /srv/mantle

config MANTEL_BASE_CACHE
	string "Where the base cache should be stored"
	depends on HAS_DL_SSTATE
	default "/srv/mantle"
	help
	  This directory will get very big. It holds all downloads and sstate
	  parser cache and much more. Make sure the user has the correct 
	  permissions to read and write to this directory.

config KAS_INCLUDE_DOWNLOADS_AND_SSTATE_OPTION
	string 
	default "distro/cache.yml" if HAS_DL_SSTATE

config BB_GENERATE_MIRROR_TARBALLS 
	string
	depends on HAS_DL_SSTATE
	default "1"

config DL_DIR
	string
	depends on HAS_DL_SSTATE
	default "${MANTEL_BASE_CACHE}/${DISTRO_CODENAME}/downloads"
 
config PRSERV_HOST
	string
	depends on HAS_DL_SSTATE
	default "localhost:0"

config CACHE_PATH 
	string
	depends on HAS_DL_SSTATE
	default "${MANTEL_BASE_CACHE}/${DISTRO_CODENAME}/${DISTRO_VERSION}/${SOC}"

config SSTATE_DIR
	string
	depends on HAS_DL_SSTATE
	default "${CACHE_PATH}/sstate-cache"

config BUILDHISTORY_DIR
	string
	depends on HAS_DL_SSTATE
	default "${CACHE_PATH}/buildhistory"

config PERSISTENT_DIR
	string
	depends on HAS_DL_SSTATE
	default "${CACHE_PATH}/cache"

config BB_CACHEDIR
	string
	depends on HAS_DL_SSTATE
	default "${CACHE_PATH}/parser-cache"

## PATHS
config SDK_DEPLOY
        string
        depends on HAS_DL_SSTATE
        default "${MANTEL_BASE_CACHE}/${RELEASE_TYPE}/sdk/${DISTRO_CODENAME}/${DISTRO_VERSION}/${MACHINE}"

config DEPLOY_DIR_IMAGE
	string
	depends on HAS_DL_SSTATE
	default "${MANTEL_BASE_CACHE}/${RELEASE_TYPE}/images/${DISTRO_CODENAME}/${DISTRO_VERSION}/${MACHINE}"

config DEPLOY_DIR_DEB
	string
        depends on HAS_DL_SSTATE
	default "${MANTEL_BASE_CACHE}/${RELEASE_TYPE}/ota/${DISTRO_CODENAME}/${DISTRO_VERSION}/deb"

config DEPLOY_DIR_RPM
        string
        depends on HAS_DL_SSTATE
        default "${MANTEL_BASE_CACHE}/${RELEASE_TYPE}/ota/${DISTRO_CODENAME}/${DISTRO_VERSION}/rpm"

config DEPLOY_DIR_IPK
        string
        depends on HAS_DL_SSTATE
        default "${MANTEL_BASE_CACHE}/${RELEASE_TYPE}/ota/${DISTRO_CODENAME}/${DISTRO_VERSION}/ipk"

config DEPLOY_DIR_TAR
        string
        depends on HAS_DL_SSTATE
        default "${MANTEL_BASE_CACHE}/${RELEASE_TYPE}/ota/${DISTRO_CODENAME}/${DISTRO_VERSION}/tar"
```

## distro/fortran/Kconfig
```kconfig
config HAS_FORTRAN
        bool "Fortran support"
        default y
        help
	  Mantle fortran support. Default is yes as some programs 
	  in the fill-repo use it. Also why not ?

config KAS_INCLUDE_FORTRAN
	string
	default "distro/fortran/fortran.yml" if HAS_FORTRAN
```

## distro/ota/Kconfig
```kconfig
menuconfig HAS_OTA
	bool "Over the air updates"
	default n

config PACKAGE_FEED_URIS
        string "server urls."
        default "https://repos.mantle-os/${REALSE_TYPE}/ota/${DISTRO_CODENAME}/${DISTRO_VERSION}/${REALSE_TYPE}/${SOC}"
        depends on HAS_OTA
	help 
	  The repos that you want to load your packages to after running packageindex 
	  this is what generates(depening on the type) the /etc/apt/source.list  on the target image
	  as well.
          See also https://docs.yoctoproject.org/ref-manual/variables.html#term-PACKAGE_FEED_URIS

choice OTA_TYPE
	prompt "The Type of OTA Packages along with the target tools."
	depends on HAS_OTA
	default RPM
	config RPM
		bool "Rpms with Dnf(Dandified YUM)"
	config APT
		bool "Deb's Apt(Advanced Package Tool)"	
	config IPK
		bool "IPK's with OPKG(Open PacKaGe Management)"
	config TAR
		bool "tar.gz only."
endchoice

# READONLY BELOW

config PACKAGE_FEED_BASE_PATHS
        string
#	prompt "PACKAGE_FEED_BASE_PATHS" if HAS_DGB_SCREENS
        depends on HAS_OTA
        default "deb" if APT
        default "rpm" if RPM
        default "ipk" if IPK
        default "tar"  if TAR
        default "" if !HAS_OTA

config PACKAGE_TYPE
        string
	depends on HAS_OTA
        default "deb" if APT
        default "rpm" if RPM
        default "ipk" if IPK
        default "tar"  if TAR
        default "" if !HAS_OTA

config PACKAGE_CLASSES
	string
	depends on HAS_OTA
	default "package_deb" if APT
        default "package_rpm" if RPM
        default "package_ipk" if IPK
        default "package_tar"  if TAR
        default "" if !HAS_O

config PACKAGE_TOOLS
        string
	depends on HAS_OTA
        default " dpkg apt " if APT
        default " rpm dnf " if RPM
        default " opkg " if IPK
        default ""  if TAR
        default "" if !HAS_OTA

config KAS_INCLUDE_HAS_OTA
	string
	default "distro/ota/ota.yml" if HAS_OTA
	default "distro/ota/no-ota.yml" if !HAS_OTA
```

## distro/pid1/Kconfig
```kconfig
menuconfig HAS_INIT_MANAGER
	bool "PID 1(Init) Managers)"
	default y

choice MANTLE_INIT_MANAGER
	prompt "Init manager"
	depends on HAS_INIT_MANAGER
        default SYSTEMD
        config SYSTEMD
		bool "systemd"
        config SYSTEMV
		bool "sys5(sysvinit)"
endchoice

config INIT_MANAGER
	string
	depends on HAS_INIT_MANAGER
	default "systemd" if SYSTEMD
	default "sysvinit" if SYSTEMV
	default "" if !HAS_INIT_MANAGER
```

## distro/unix_tools/Kconfig
```kconfig
menuconfig HAS_BASE_UTILS
	bool "Base Utilities(UNIX tools)"
	default y

choice BASE_UTILS
	prompt "Base Utilities"
	depends on HAS_BASE_UTILS
	default COREUTILS
	config COREUTILS
		bool "GNU coreutils(full cmdline)"
	config BUSYBOX
		bool "busybox"
	config TOYBOX
		bool "toybox"
endchoice

config KAS_INCLUDE_BASE_UTILS
	string
	default "distro/unix_tools/coreutils.yml" if COREUTILS
	default "distro/unix_tools/busybox.yml" if BUSYBOX
	default "distro/unix_tools/toybox.yml" if TOYBOX
```

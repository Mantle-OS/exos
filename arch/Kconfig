## arch/Kconfig
```kconfig
menu "ARCH(Architechtures)"

comment "Architechture"

config ARCH_GFX_ALL
        bool
          select HAS_OPENGL
          select HAS_WAYLAND
          select HAS_KMS
          select HAS_DRM
          select HAS_WEB_ENGINE
          select HAS_X11

choice ARCH
        prompt "Supported Architechtures"
        default X86_64
        config X86
                bool "X86 32 bit"
                select ARCH_GFX_ALL
        config X86_64
                bool "x86 64 bit"
                select ARCH_GFX_ALL
        config ARM
                bool "Arm 32 bit"
        config ARM64
                bool "ARM 64"
        config POWER_PC
                bool "PowerPC 32 bit"
        config POWER_PC
                bool "PowerPC 64 bit"
        config MIPS
                bool "Mips 32bit"
        config MIPS64
                bool "Mips 64"

endchoice

comment "Board" 
# its really the tune
source "arch/arm/Kconfig"
source "arch/arm64/Kconfig"
source "arch/x86/Kconfig"
source "arch/x86_64/Kconfig"

endmenu
```

## arch/arm/Kconfig
```kconfig
choice ARM_SOC
	prompt "Unsupported at the moment. Will come soon"
	depends on ARM
	default GENERIC_ARM
	config GENERIC_ARM_V5
		bool "Generic armv5"
	config GENERIC_ARM_V7
		bool "Generic armv7hf"
endchoice

config KAS_INCLUDE_ARM_ARCH
	string
	default "arch/arm/armv5.yml" if GENERIC_ARM_V5
	default "arch/arm/armv7.yml" if GENERIC_ARM_V7

## Source all the soc vendors here.
```

## arch/arm64/Kconfig
```kconfig
choice ARM64_SOC
	prompt "Arm 64 test boards"
	depends on ARM64
	default GENERIC_ARM64
	config GENERIC_ARM64
		bool "Mantle generic aarm64"
endchoice

config KAS_INCLUDE_ARM64_ARCH
	string
	default "arch/arm64/arm64.yml" if ARM64
```

## arch/x86_64/Kconfig
```kconfig
choice X86_64_TUNE
	prompt "please pick out a supported tune"
	depends on X86_64
	default HASWELL_CPU
	help
	  * Nehalem: meta-intel's corei7-64 which add more support for sse and ss4e. But not for  avx. avx, avx2, avx-vinni, avx512
	  * Haswell(default) Supports: sse4, avx, avx2, Unsupported: avx-vnni, avx-512 also known as x86-64-v3
	  * Skylake x86-64-v4 Supports: sse4, avx, avx2, avx-512 also known as x86-64-v4
	config NEHALEM_CPU
		bool "corei7-64"
	config HASWELL_CPU
		bool "Haswell x86_64 v3(Default)"
	config SKYLAKE_CPU
		bool "Skylake"
endchoice

config KAS_INCLUDE_X86_64_ARCH
	string
	default "arch/x86_64/i7.yml" if NEHALEM_CPU
	default "arch/x86_64/x86-86-v3.yml" if HASWELL_CPU
	default "arch/x86_64/x86-86-v4.yml" if SKYLAKE_CPU
```

## distro/Kconfig
```kconfig
menu "File Path Options"
comment "Various options for pathing on the build settings"

config HAS_DL_SSTATE
        bool "Enable Cache Downloads and sstate"
        default y
        help
          This allows one to set the base directory to where
          all the sstate, downloads, parser-cache, prserv, This
          saves hours on builds over time. The directories must
          exsist on the system with the correct user permissions
          to read and write to the folder. example.
          sudo mkdir -p /srv/mantle;
          sudo chown -R $USER:$USER /srv/yocto/mantle

config KAS_INCLUDE_DOWNLOADS_AND_SSTATE_OPTION
        string
        default "distro/cache.yml" if HAS_DL_SSTATE

config MANTEL_BASE_CACHE
        string "Where the base cache should be stored"
        depends on HAS_DL_SSTATE
        default "/srv/yocto/mantle"
        help
          This directory will get very big. It holds all downloads and sstate
          parser cache and much more. Make sure the user has the correct
          permissions to read and write to this directory.

config BB_GENERATE_MIRROR_TARBALLS 
        string "BB_GENERATE_MIRROR_TARBALLS"
        depends on HAS_DL_SSTATE
        default "1"
        help
         Causes tarballs of the Git repositories, including the Git metadata,
         to be placed in the DL_DIR directory. Anyone wishing to create a source
         mirror would want to enable this variable.

config DL_DIR
        string
        prompt "DL_DIR"
        depends on HAS_DL_SSTATE
        default "${MANTEL_BASE_CACHE}/${DISTRO_CODENAME}/downloads"
        help
          The central download directory used by the build process to store downloads.
 

config PRSERV_HOST
        string
        prompt "PRSERV_HOST"
        depends on HAS_DL_SSTATE
        default "localhost:0"
        help
          The network based PR service host and port.
#
config CACHE_PATH 
        string "CACHE_PATH"
        depends on HAS_DL_SSTATE
        default "${MANTEL_BASE_CACHE}/${DISTRO_CODENAME}/${DISTRO_VERSION}/${TUNE_ARCH}"
        help
          Directory that holds cache files


config SSTATE_DIR
        string "SSTATE_DIR"
        depends on HAS_DL_SSTATE
        default "${CACHE_PATH}/sstate-cache"
        help
          The directory for the shared state cache.

config BUILDHISTORY_DIR
        string "BUILDHISTORY_DIR"
        depends on HAS_DL_SSTATE
        default "${CACHE_PATH}/buildhistory"
        help
          When inheriting the buildhistory class, this variable specifies the directory in which build history
          information is kept. For more information on how the variable works, see the buildhistory class.

config PERSISTENT_DIR
        string "PERSISTENT_DIR"
        depends on HAS_DL_SSTATE
        default "${CACHE_PATH}/cache"
        help
          Specifies the directory BitBake uses to store data that should be preserved between builds.
          In particular, the data stored is the data that uses BitBake’s persistent data API,
          the data used by the PR Server and PR Service, and the default location of
          the Hash Equivalence databas

config BB_CACHEDIR
        string "BB_CACHEDIR"
        depends on HAS_DL_SSTATE
        default "${CACHE_PATH}/parser-cache"
        help
          Specifies the code parser cache directory distinct from CACHE and PERSISTENT_DIR.


## PATHS
config SDK_DEPLOY
        string "SDK_DEPLOY"
        depends on HAS_DL_SSTATE
        default "${MANTEL_BASE_CACHE}/${RELEASE_TYPE}/sdk/${DISTRO_CODENAME}/${DISTRO_VERSION}/${MACHINE}"
        help
          Where the SDK is wrote to when building a sdk image

config DEPLOY_DIR_IMAGE
        string "DEPLOY_DIR_IMAGE"
        depends on HAS_DL_SSTATE
        default "${MANTEL_BASE_CACHE}/${RELEASE_TYPE}/images/${DISTRO_CODENAME}/${DISTRO_VERSION}/${MACHINE}"
        help
          Points to the area that the Exos build system uses to place images
          and other associated output files that are ready to be deployed onto
          the target machine

config DEPLOY_DIR_DEB
        string "DEPLOY_DIR_DEB"
        depends on HAS_DL_SSTATE
        default "${MANTEL_BASE_CACHE}/${RELEASE_TYPE}/ota/${DISTRO_CODENAME}/${DISTRO_VERSION}/deb"
        help
          Points to the area that the Exos build system uses to place Debian packages
          that are ready to be used outside of the build system

config DEPLOY_DIR_RPM
        string "DEPLOY_DIR_RPM"
        depends on HAS_DL_SSTATE
        default "${MANTEL_BASE_CACHE}/${RELEASE_TYPE}/ota/${DISTRO_CODENAME}/${DISTRO_VERSION}/rpm"
        help
          Points to the area that the Exos build system uses to place RPM packages
          that are ready to be used outside of the build system
config DEPLOY_DIR_IPK
        string "DEPLOY_DIR_IPK"
        depends on HAS_DL_SSTATE
        default "${MANTEL_BASE_CACHE}/${RELEASE_TYPE}/ota/${DISTRO_CODENAME}/${DISTRO_VERSION}/ipk"
        help
          Points to the area that the Exos build system uses to place IPK packages
          that are ready to be used outside of the build system

config DEPLOY_DIR_TAR
        string "DEPLOY_DIR_TAR"
        depends on HAS_DL_SSTATE
        default "${MANTEL_BASE_CACHE}/${RELEASE_TYPE}/ota/${DISTRO_CODENAME}/${DISTRO_VERSION}/tar"
        help
          Points to the area that the Exos build system uses to place TAR Ball packages
          that are ready to be used outside of the build system

endmenu
```

## distro/build_time/Kconfig
```kconfig
menu "Build Time Options"
comment "Build time options for Exos"


comment "INHERIT Buildtime Options"
config HAS_RM_WORK
        bool
        prompt "INHERIT += rm_work"
        default y
        help
          removes the work after the bnuild great for saving space and ci/cd
          horrible when you want to debug something
config KAS_INCLUDE_RM_WORK_OPTION
        string
        default "distro/build_time/enable-rmwork.yml" if HAS_RM_WORK
        default "distro/build_time/disable-rmwork.yml" if !HAS_RM_WORK

config HAS_SPDX
        bool
        prompt "INHERIT += create-spdx"
        default n
        help
          creates the spdk slash sbom for the build. Great if you are releasing code
config KAS_INCLUDE_SPDX_OPTION
        string
        default "distro/build_time/enable-spdx.yml" if HAS_SPDX
        default "distro/build_time//disable-spdx.yml" if !HAS_SPDX

config HAS_CVE
        bool
        prompt "INHERIT += cve-check"
        default n
        help
          run a simple cve check on the code base. Note full resolve anything or understand
          false positives etc
config KAS_INCLUDE_CVE_OPTION
        string
        default "distro/build_time/enable-cve.yml" if HAS_CVE
        default "distro/build_time/disable-cve.yml" if !HAS_CVE


comment "Toolchain buildtime Options"


config HAS_FORTRAN
        bool "Fortran support"
        default y
        help
          Mantle fortran support. Default is yes as some programs
          in the fill-repo use it. Also why not ?
config KAS_INCLUDE_FORTRAN
        string
        default "distro/fortran/fortran.yml" if HAS_FORTRAN






endmenu
```

## distro/de/Kconfig
```kconfig
menu "Images"
comment "Avalible Images"

config HAS_CORE_IMG
    bool "mantle-image-core"
    default y
config KAS_INCLUDE_MANTLE_IMAGE_CORE
  string
  default "distro/de/core.yml" if HAS_CORE_IMG

config HAS_FULL_IMG
    bool "mantle-image-full"
config KAS_INCLUDE_MANTLE_IMAGE_FULL_
  string
  default "distro/de/full.yml" if HAS_FULL_IMG


config HAS_DOCKER_IMG
    bool "mantle-image-docker"
config KAS_INCLUDE_MANTLE_IMAGE_DOCKER
  string
  default "distro/de/docker.yml" if HAS_DOCKER_IMG


config HAS_SELF_IMG
    bool "mantle-image-self"
config KAS_INCLUDE_MANTLE_IMAGE_SELF
  string
  default "distro/de/docker.yml" if HAS_SELF_IMG



config HAS_WESTON_IMG
    bool "mantle-image-weston"
    depends on HAS_WAYLAND
config KAS_INCLUDE_MANTLE_IMAGE_WAYLAND_WESTON
  string
  default "distro/de/weston.yml" if HAS_WESTON_IMG

## x11
config HAS_GNOME_IMG
    bool "mantle-image-gnome"
    depends on HAS_X11

config KAS_INCLUDE_MANTLE_IMAGE_GNOME
  string
  default "distro/de/gnome.yml" if HAS_GNOME_IMG


config HAS_KDE6_IMG
    bool "mantle-image-kde6"
    depends on HAS_X11
config KAS_INCLUDE_MANTLE_IMAGE_KDE6
  string
  default "distro/de/kde6.yml" if HAS_KDE6_IMG

config HAS_XFCE_IMG
    bool "mantle-image-xfce"
    depends on HAS_X11
config KAS_INCLUDE_MANTLE_IMAGE_XFCE
  string
  default "distro/de/xfce.yml" if HAS_XFCE_IMG


config HAS_INSTALLER_IMG
    bool "mantle-image-installer"
    depends on ARCH = "X86_64"
config KAS_INCLUDE_MANTLE_IMAGE_INSTALLER
  string
  default "distro/de/installer.yml" if HAS_INSTALLER_IMG


config HAS_RECOVERY_IMG
    bool "mantle-image-recovery"
    depends on ARCH = "X86_64"
config KAS_INCLUDE_MANTLE_IMAGE_RECOVERY
  string
  default "distro/de/recovery.yml" if HAS_RECOVERY_IMG


endmenu
```

## distro/gfx/Kconfig
```kconfig
config HAS_OPENGL
    bool
config HAS_DRM
    bool
config HAS_KMS
    bool
config HAS_X11
    bool
config HAS_WAYLAND
    bool
config HAS_WEB_ENGINE
    bool
```

## distro/ota/Kconfig
```kconfig
menu "Over the Air Updates"
comment "OTA"

config HAS_OTA
        bool "Over the air updates"
        default y
        help
          Enables over the air updates via the repository setup

config PACKAGE_FEED_URIS
        string "Server URLs"
        default "https://127.0.0.1:8088/${RELEASE_TYPE}/ota/${DISTRO_CODENAME}/${DISTRO_VERSION}/${RELEASE_TYPE}/${TUNE_ARCH}"
        depends on HAS_OTA
        help
          The repos that you want to load your packages to after running packageindex
          this is what generates(depening on the type) the /etc/apt/source.list  on the target image as well.
          See also https://docs.yoctoproject.org/ref-manual/variables.html#term-PACKAGE_FEED_URIS

choice OTA_TYPE
        prompt "The Type of OTA Packages along with the target tools."
        depends on HAS_OTA
        default RPM if HAS_OTA
        config RPM
                bool "Rpms with Dnf(Dandified YUM)"
        config APT
                bool "Deb's Apt(Advanced Package Tool)"
        config IPK
                bool "IPK's with OPKG(Open PacKaGe Management)"
        config TAR
                bool "tar.gz only."
endchoice

# READONLY BELOW
config PACKAGE_FEED_BASE_PATHS
        string
        depends on HAS_OTA
        default "deb" if APT
        default "rpm" if RPM
        default "ipk" if IPK
        default "tar"  if TAR
        default "none" if !HAS_OTA

config PACKAGE_TYPE
        string
        depends on HAS_OTA
          default "deb" if APT
          default "rpm" if RPM
          default "ipk" if IPK
          default "tar"  if TAR
          default "none" if !HAS_OTA

config PACKAGE_CLASSES
        string
        depends on HAS_OTA
          default "package_deb" if APT
          default "package_rpm" if RPM
          default "package_ipk" if IPK
          default "package_tar"  if TAR
          default "package_none" if !HAS_OTA

config PACKAGE_TOOLS
        string
        depends on HAS_OTA
          default " dpkg apt " if APT
          default " rpm dnf " if RPM
          default " opkg " if IPK
          default " tar "  if TAR
          default " tar " if !HAS_OTA

config KAS_INCLUDE_HAS_OTA
        string
        default "distro/ota/ota.yml" if HAS_OTA
        default "distro/ota/no-ota.yml" if !HAS_OTA


endmenu
```

## distro/pid1/Kconfig
```kconfig
menu "PID 1 Managers"
comment "What is the 1st program to run ?"

config HAS_INIT_MANAGER
        bool "Enable PID 1(Init) Managers)"
        default y

choice MANTLE_INIT_MANAGER
        prompt "Init manager"
        depends on HAS_INIT_MANAGER
        default SYSTEMD
        config SYSTEMD
                bool "systemd"
        config SYSTEMV
                bool "sys5(sysvinit)"
        config ERLINIT
                bool "erlinit is a replacement for /sbin/init that launches an Erlang/OTP Release"
endchoice

config INIT_MANAGER
        string
        depends on HAS_INIT_MANAGER
        default "systemd"  if SYSTEMD
        default "sysvinit" if SYSTEMV
        default "erlinit"  if ERLINIT
        default "" if !HAS_INIT_MANAGER

endmenu
```
